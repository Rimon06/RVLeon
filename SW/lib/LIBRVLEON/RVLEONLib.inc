###############################

.eqv IO_BASE, 0x80000000

.eqv IO_BUTTON,       0x00
.eqv IO_LEDS,         0x04
.eqv IO_LEDS_config,  0x08

.eqv IO_UART,         0x0c
.eqv IO_UART_TX_READY,0x0d
.eqv IO_UART_RX_leido,0x0e

.eqv IO_KBRD_status,  0x10
.eqv IO_KBRD_keys,    0x14
.eqv IO_KBRD_key0,    0x14
.eqv IO_KBRD_key1,    0x15
.eqv IO_KBRD_key2,    0x16
.eqv IO_KBRD_key3,    0x17

.eqv IO_mouse_status, 0x18
.eqv IO_mouse_data,   0x1c

.eqv IO_SSD1306_CMD,  0x20
.eqv IO_SSD1306_busy, 0x21
.eqv IO_SSD1306_DAT,  0x24

.eqv IO_VGA_CMD,     0x28
.eqv IO_VGA_TXT_COL,  0x2a
.eqv IO_VGA_BKG_COL,  0x2b

.eqv IO_VGA_RAM_BASE, 0x2000

